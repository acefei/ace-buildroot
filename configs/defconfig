## configs/defconfig
```kconfig
# Kernel
BR2_LINUX_KERNEL=y
BR2_LINUX_KERNEL_VERSION="4.19.88"
BR2_LINUX_KERNEL_USE_CUSTOM_CONFIG=y
BR2_LINUX_KERNEL_CUSTOM_CONFIG_FILE="$(BR2_EXTERNAL_{external_name}_PATH)/configs/{external_name}_kernel.config"
BR2_DEFAULT_KERNEL_HEADERS="4.19.88"
BR2_KERNEL_HEADERS_4_19=y
BR2_TOOLCHAIN_HEADERS_AT_LEAST="4.19"

# Busybox
BR2_PACKAGE_BUSYBOX=y
BR2_PACKAGE_BUSYBOX_CONFIG="$(BR2_EXTERNAL_{external_name}_PATH)/configs/{external_name}_busybox.config"

# GCC Options
BR2_GCC_VERSION_7_X=y
BR2_GCC_VERSION="7.4.0"

# System configuration
BR2_DL_DIR="$(BASE_DIR)/dl"
#BR2_TARGET_GENERIC_HOSTNAME=
#BR2_TARGET_GENERIC_ISSUE=
```
